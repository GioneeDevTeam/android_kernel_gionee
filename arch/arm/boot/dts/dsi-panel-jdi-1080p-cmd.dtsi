/* Copyright (c) 2012, Code Aurora Forum. All rights reserved.
 *
 * This program is free software; you can redistribute it and/or modify
 * it under the terms of the GNU General Public License version 2 and
 * only version 2 as published by the Free Software Foundation.
 *
 * This program is distributed in the hope that it will be useful,
 * but WITHOUT ANY WARRANTY; without even the implied warranty of
 * MERCHANTABILITY or FITNESS FOR A PARTICULAR PURPOSE.  See the
 * GNU General Public License for more details.
 */

&soc {

	qcom,mdss_dsi_jdi_command_ors {
		compatible = "qcom,mdss-dsi-panel";
		label = "JDI 1080p command mode dsi panel";
		status = "ok";
		qcom,cont-splash-enabled;
		qcom,dsi-ctrl-phandle = <&mdss_dsi0>;
		qcom,enable-gpio = <&msmgpio 58 0>;
		qcom,rst-gpio = <&pm8941_gpios 19 0>;
		qcom,te-gpio = <&msmgpio 12 0>;
		qcom,mdss-pan-id = <5>;
		qcom,mdss-pan-res = <1080 1920>;
		qcom,mdss-pan-bpp = <24>;
		qcom,mdss-pan-width = <62>;
		qcom,mdss-pan-height = <110>;
		qcom,mdss-pan-dest = "display_1";
		qcom,mdss-pan-porch-values = <2 2 4 2 2 2>;
		qcom,mdss-pan-underflow-clr = <0xff>;
		qcom,mdss-pan-bl-ctrl = "bl_ctrl_wled";
		qcom,mdss-pan-bl-levels = <1 255>;
		qcom,mdss-pan-dsi-mode = <1>;
		qcom,mdss-vsync-enable = <1>;
		qcom,mdss-hw-vsync-mode = <1>;
		qcom,mdss-pan-dsi-h-pulse-mode = <0>;
		qcom,mdss-pan-dsi-h-power-stop = <0 0 0>;
		qcom,mdss-pan-dsi-bllp-power-stop = <1 1>;
		qcom,mdss-pan-dsi-traffic-mode = <1>;
		qcom,mdss-pan-dsi-dst-format = <8>;
		qcom,mdss-pan-dsi-vc = <0>;
		qcom,mdss-pan-dsi-rgb-swap = <0>;
		qcom,mdss-pan-dsi-data-lanes = <1 1 1 1>;
		qcom,mdss-pan-dsi-dlane-swap = <0>;
		qcom,mdss-pan-dsi-t-clk = <0x35 0x1E>;
		qcom,mdss-pan-dsi-stream = <0>;
		qcom,mdss-pan-dsi-mdp-tr = <0x0>;
		qcom,mdss-pan-dsi-dma-tr = <0x04>;
		qcom,mdss-pan-dsi-frame-rate = <60>;
		qcom,mdss-pan-clk-rate = <804667392>;
		qcom,mdss-pan-te-sel = <1>;
		qcom,mdss-pan-wr-mem-continue = <0x3c>;
		qcom,mdss-pan-wr-mem-start = <0x2c>;
		qcom,mdss-pan-insert-dcs-cmd = <1>;
		qcom,panel-phy-regulatorSettings = [
			07 09 03 00  /* Regualotor settings */
			20 00 01];
		qcom,panel-phy-timingSettings = [
			c1 3d 34 00 58 4d
			36 3f 53 03 04 00];
		qcom,panel-phy-strengthCtrl = [
			bb 06];
		qcom,panel-phy-bistCtrl = [
			00 00 b1 ff           /* BIST Ctrl settings */
			00 00];
		qcom,panel-phy-laneConfig = [
			00 c2 45 00 00 00 00 01 75 /* lane0 config */
			00 c2 45 00 00 00 00 01 75 /* lane1 config */
			00 c2 45 00 00 00 00 01 75 /* lane2 config */
			00 c2 45 00 00 00 00 01 75 /* lane3 config */
			00 02 45 00 00 00 00 01 97]; /* Clk ln config */
		qcom,panel-on-cmds = [
			15 01 00 00 00 00 02 00 00
			39 01 00 00 00 00 05
			FF 19 02 01 00
			15 01 00 00 00 00 02 00 80
			39 01 00 00 00 00 03
			FF 19 02
			15 01 00 00 00 00 02 00 00
			39 01 00 00 00 00 03
			D8 20 20
			15 01 00 00 00 00 02 00 00
			39 01 00 00 00 00 19
			E1 00 0A 11 1B 25
			2D 38 48 53 65 70
			79 80 7B 75 6A 5B
			4E 44 3E 35 26 16
			00
			15 01 00 00 00 00 02 00 00
			39 01 00 00 00 00 19
			E2 00 0A 11 1B 25
			2D 38 48 53 65 70
			79 80 7B 75 6A 5B
			4E 44 3E 35 26 16
			00
			15 01 00 00 00 00 02 00 00
			39 01 00 00 00 00 19
			E3 47 49 4B 4E 51
			54 5A 64 69 75 7C
			82 79 75 6F 64 55
			49 40 3A 32 25 15
			00
			15 01 00 00 00 00 02 00 00
			39 01 00 00 00 00 19
			E4 47 49 4B 4E 51
			54 5A 64 69 75 7C
			82 79 75 6F 64 55
			49 40 3A 32 25 15
			00
			15 01 00 00 00 00 02 00 00
			39 01 00 00 00 00 19
			E5 56 57 59 5B 5E
			60 65 6D 6F 79 7E
			83 78 74 6E 63 54
			47 3D 34 28 21 14
			00
			15 01 00 00 00 00 02 00 00
			39 01 00 00 00 00 19
			E6 56 57 59 5B 5E
			60 65 6D 6F 79 7E
			83 78 74 6E 63 54
			47 3D 34 28 21 14
			00
			15 01 00 00 00 00 02 00 00
			15 01 00 00 00 00 02 00 00
			39 01 00 00 00 00 05
			FF 19 02 01 00
			15 01 00 00 00 00 02 00 80
			39 01 00 00 00 00 03
			FF 19 02
			15 01 00 00 00 00 02 00 83
			15 01 00 00 00 00 02 F3 CA
			15 01 00 00 00 00 02 00 90
			15 01 00 00 00 00 02 C4 00
			15 01 00 00 00 00 02 00 B0
			39 01 00 00 00 00 0F
			C5 92 D6 A0 15 A0 1E A0 06
			A0 0C 44 33 30 88
			15 01 00 00 00 00 02 00 00
			15 01 00 00 00 00 02 35 00
			39 01 00 00 00 00 05
			2A 00 00 04 37
			39 01 00 00 00 00 05
			2B 00 00 07 7F
			05 01 00 00 78 00 01 11
			05 01 00 00 00 00 01 29];
		qcom,on-cmds-dsi-state = "DSI_LP_MODE";
		qcom,panel-off-cmds = [
			05 01 00 00 32 00 01 28
			05 01 00 00 64 00 01 10];
		qcom,off-cmds-dsi-state = "DSI_HS_MODE";
	};
};
